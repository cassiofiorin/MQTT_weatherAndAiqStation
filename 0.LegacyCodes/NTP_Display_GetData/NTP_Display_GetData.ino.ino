#include <SPI.h>
#include <Wire.h>
#include <Adafruit_GFX.h>
#include <Adafruit_SSD1306.h>
#include <WiFi.h>
#include <time.h>
//#include <ArduinoJson.h>
#include <Arduino_JSON.h>
#include <WiFiClientSecure.h>
#include <HTTPClient.h>
#include <Arduino.h>

#define NTP_SERVER     "time.cloudflare.com"
#define UTC_OFFSET     -10800
#define UTC_OFFSET_DST 0

#define SCREEN_WIDTH 128 // OLED display width, in pixels
#define SCREEN_HEIGHT 64 // OLED display height, in pixels

// Declaration for an SSD1306 display connected to I2C (SDA, SCL pins)
#define OLED_RESET     -1 // Reset pin # (or -1 if sharing Arduino reset pin)
Adafruit_SSD1306 display(SCREEN_WIDTH, SCREEN_HEIGHT, &Wire, OLED_RESET);

const char* ssid = "wifiName";  // Enter SSID here
const char* password = "wifiPass";  //Enter Password here

// 'clima', 128x64px
const unsigned char EstacaoClima [] PROGMEM = {
  0x00, 0x00, 0x00, 0x00, 0x00, 0x00, 0x00, 0x00, 0x00, 0x00, 0x00, 0x00, 0x00, 0x00, 0x00, 0x00, 
  0x00, 0x00, 0x00, 0x00, 0x00, 0x00, 0x00, 0x00, 0x00, 0x00, 0x00, 0x00, 0x00, 0x00, 0x00, 0x00, 
  0x00, 0x00, 0x00, 0x00, 0x00, 0x00, 0x00, 0x00, 0x00, 0x00, 0x00, 0x00, 0x00, 0x00, 0x00, 0x00, 
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  0x00, 0x00, 0x00, 0x00, 0x00, 0x00, 0x00, 0x00, 0x00, 0x00, 0x00, 0x00, 0x00, 0x00, 0x00, 0x00
};

String openWeatherMapApiKey = "apiKey";
String lat = "-25.4";
String lon = "-49.2";

// THE DEFAULT TIMER IS SET TO 10 SECONDS FOR TESTING PURPOSES
// For a final application, check the API call limits per hour/minute to avoid getting blocked/banned
unsigned long lastTime = 0;
// Timer set to 10 minutes (600000)
//unsigned long timerDelay = 600000;
// Set timer to 10 seconds (10000)
unsigned long timerDelay = 10000;

String jsonBuffer;


void printLocalTime() {
  struct tm timeinfo;
  if (!getLocalTime(&timeinfo)) {
    display.setCursor(10, 10);
    display.println("Connection Err");
    display.display();
    return;
  }

  display.setCursor(1, 1);
  display.println(&timeinfo, "%d/%m/%Y");
  display.display();

  display.setCursor(1, 10);
  display.println(&timeinfo, "%H:%M:%S");
  display.display();
}


//WiFiClientSecure client;
void capturaClima(){
// Send an HTTP GET request
//  if ((millis() - lastTime) > timerDelay) {
    // Check WiFi connection status
    if(WiFi.status()== WL_CONNECTED){
      String serverPath = "http://api.openweathermap.org/data/2.5/weather?lat=" + lat + "&lon=" + lon + "&APPID=" + openWeatherMapApiKey + "&units=metric&lang=pt_br";
      
      jsonBuffer = httpGETRequest(serverPath.c_str());
      Serial.println(jsonBuffer);
      JSONVar myObject = JSON.parse(jsonBuffer);
  
      // JSON.typeof(jsonVar) can be used to get the type of the var
      if (JSON.typeof(myObject) == "undefined") {
        Serial.println("Parsing input failed!");
        return;
      }
    
    //  Serial.print("JSON object = ");
      Serial.println(myObject);
      Serial.print("Temperatura Atual: ");
      Serial.println(myObject["main"]["temp"]);
      Serial.print("Pressão Atmosférica: ");
      Serial.println(myObject["main"]["pressure"]);
      Serial.print("Umidade: ");
      Serial.println(myObject["main"]["humidity"]);
      Serial.print("Velocidade do vento: ");
      Serial.println(myObject["wind"]["speed"]);
    }
    else {
      Serial.println("WiFi Disconnected");
    }
    lastTime = millis();
  }

  
String httpGETRequest(const char* serverName) {
  WiFiClient client;
  HTTPClient http;
    
  // Your Domain name with URL path or IP address with path
  http.begin(client, serverName);
  
  // Send HTTP POST request
  int httpResponseCode = http.GET();
  
  String payload = "{}"; 
  
  if (httpResponseCode>0) {
    Serial.print("HTTP Response code: ");
    Serial.println(httpResponseCode);
    payload = http.getString();
  }
  else {
    Serial.print("Error code: ");
    Serial.println(httpResponseCode);
  }
  // Free resources
  http.end();

  return payload;
}




void setup() {
  int tries = 0;
  Serial.begin(115200);
  // SSD1306_SWITCHCAPVCC = generate display voltage from 3.3V internally
  if(!display.begin(SSD1306_SWITCHCAPVCC, 0x3C)) { 
    Serial.println(F("SSD1306 allocation failed"));
    for(;;); // Don't proceed, loop forever
  }
  // Clear the buffer
  display.clearDisplay();
  splashScreen();

Serial.println("Iniciando");
  WiFi.begin(ssid, password);;
  Serial.println("Conectando");
  while (WiFi.status() != WL_CONNECTED) {
    
    delay(500);
    tries++;
    Serial.println(String("Tentativa de conexão: ") +tries);
  }

  Serial.println("");
  Serial.println("WiFi conectado!");
  Serial.print("IP: ");
  Serial.println(WiFi.localIP());

  configTime(UTC_OFFSET, UTC_OFFSET_DST, NTP_SERVER);

  capturaClima();
}



void loop() {
  display.clearDisplay();
  printLocalTime();
  delay(1000);  
}


void splashScreen(void){
  display.clearDisplay();
  display.drawBitmap(0, 0, EstacaoClima, 128, 64, WHITE); // display.drawBitmap(x position, y position, bitmap data, bitmap width, bitmap height, color)
  display.display();
  delay(500);

  display.setTextSize(1);
  display.setTextColor(WHITE);
  display.setCursor (20, 0);
  display.println(F(">>>Iniciando>>>"));
  display.display();
  delay(1000);
}
